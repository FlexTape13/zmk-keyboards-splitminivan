## boards/shields/splitminivan/Kconfig.defconfig
```kconfig
if SHIELD_SPLITMINIVAN_LEFT

config ZMK_KEYBOARD_NAME
    default "split_minivan"

config ZMK_SPLIT_ROLE_CENTRAL
    default y

endif # SHIELD_SPLITMINIVAN_LEFT

if SHIELD_SPLITMINIVAN_LEFT || SHIELD_SPLITMINIVAN_RIGHT

config ZMK_SPLIT
    default y

config ZMK_SPLIT_BLE
    default y

config ZMK_SPLIT_BLE_CENTRAL_PERIPHERALS
    default 1

endif # SHIELD_SPLITMINIVAN_LEFT || SHIELD_SPLITMINIVAN_RIGHT

config ZMK_STUDIO
    default y
```

## boards/shields/splitminivan/Kconfig.shield
```kconfig
config SHIELD_SPLITMINIVAN_LEFT
    def_bool $(shields_list_contains,splitminivan_left)

config SHIELD_SPLITMINIVAN_RIGHT
    def_bool $(shields_list_contains,splitminivan_right)
```
